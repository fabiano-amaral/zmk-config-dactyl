## config/boards/shields/dactyl/Kconfig.defconfig
```kconfig
if SHIELD_DACTYL_LEFT

config ZMK_KEYBOARD_NAME
    default "dactyl_left"

endif

if SHIELD_DACTYL_RIGHT

config ZMK_KEYBOARD_NAME
    default "dactyl_right"
endif

if SHIELD_DACTYL_LEFT || SHIELD_DACTYL_RIGHT

    config ZMK_SPLIT
        default y

endif
```

## config/boards/shields/dactyl_left/Kconfig.defconfig
```kconfig
if SHIELD_DACTYL_LEFT

config ZMK_KEYBOARD_NAME
    default "dactyl_left"

endif
```
